## meta-toradex/conf/machine/colibri-t20.conf
```bitbake
#@TYPE: Machine
#@NAME: colibri_t20
#@DESCRIPTION: Toradex Colibri T20

require conf/machine/include/tegra-base.inc

SOC_FAMILY = "tegra:tegra2"

PREFERRED_PROVIDER_virtual/kernel = "linux-toradex"

KERNEL_IMAGETYPE = "zImage"

# U-Boot expects the kernel directly in /boot of the rootfs
MACHINE_ESSENTIAL_EXTRA_RDEPENDS += "kernel-image"

PREFERRED_PROVIDER_u-boot = "u-boot-toradex"
PREFERRED_PROVIDER_virtual/bootloader = "u-boot-toradex"
UBOOT_MACHINE = "colibri_t20_defconfig"
UBOOT_ENTRYPOINT = "0x00008000"

# Only has DVI connector for external screen, name is changing to MACHINE_GUI_CLASS
GUI_MACHINE_CLASS = "bigscreen"
MACHINE_GUI_CLASS = "bigscreen"

PREFERRED_PROVIDER_lxde-icon-theme_colibri-t20 = "lxde-icon-theme"
PREFERRED_PROVIDER_lxsession-lite_colibri-t20 = "lxsession"
PREFERRED_PROVIDER_virtual/psplash = "psplash-angstrom"
PREFERRED_PROVIDER_psplash-support = "psplash-angstrom"

MACHINE_FEATURES = "screen usbgadget usbhost vfat ext2 alsa touchscreen wifi bluetooth 3g"
EXTRA_IMAGEDEPENDS += "u-boot"

# used by sysvinit_2
SERIAL_CONSOLE = "115200 ttyS0"
IMAGE_FSTYPES ?= "tar.bz2"

# T20 does not have neon
DEFAULTTUNE = "armv7athf"
#choose a specific vfp, or we end up with the default vfpv2 optimization
TUNE_CCARGS += "-mfpu=vfpv3-d16"
require conf/machine/include/tune-cortexa9.inc
```

## meta-toradex/conf/machine/include/tegra-base.inc
```bitbake
# Provides common Tegra SoC settings

require conf/machine/include/soc-family.inc

# Tegra binaries require a specific X-Server binary ABI
PREFERRED_PROVIDER_virtual/xserver_tegra = "xserver-xorg"
PREFERRED_VERSION_xserver-xorg_tegra = "99:1.14%"
XSERVER = "xserver-xorg \
           xf86-input-evdev \
           xf86-input-mouse \
           xf86-video-fbdev \
           xf86-input-keyboard"

PREFERRED_PROVIDER_virtual/mesa = "mesa"
PREFERRED_PROVIDER_virtual/egl = "trdx-nv-binaries"
PREFERRED_PROVIDER_virtual/libgles1 = "trdx-nv-binaries"
PREFERRED_PROVIDER_virtual/libgles2 = "trdx-nv-binaries"

# Install NV binaries which contains tegra X-Server drivers when X11 is chosen
MACHINE_EXTRA_RRECOMMENDS_append_tegra = " ${@base_contains('DISTRO_FEATURES', 'x11', 'trdx-nv-binaries', '', d)}"
```
